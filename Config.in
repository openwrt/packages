## Config.in
```kconfig
config KMOD_BATMAN_ADV_DEBUG_LOG
	bool "enable verbose debug logging"
	depends PACKAGE_kmod-batman-adv
	default n
config KMOD_BATMAN_ADV_BATCTL
	bool "enable batctl"
	depends PACKAGE_kmod-batman-adv
	default y
	help
	  batctl is a more intuitive managment utility for B.A.T.M.A.N.-Advanced.
	  It is an easier method for configuring batman-adv and
	  provides some additional tools for debugging as well.
```

## admin/ipmitool/Config.in
```kconfig
if PACKAGE_ipmitool

config IPMITOOL_KERNEL_MODULES
	bool "Select system interface kernel modules for ipmitool"
	default n
	select PACKAGE_kmod-ipmi-handler
	select PACKAGE_kmod-ipmi-si
	select PACKAGE_kmod-ipmi-device-interface
	help
	  If not set, no kernel modules get installed on ipmitool package
	  installation. The package ipmitool needs this kernel modules to
	  work properly with the system interface.
	  If in doubt, say "Y".

endif
```

## admin/openwisp-monitoring/Config.in
```kconfig
menu "netjson-monitoring Configuration"
	depends on PACKAGE_netjson-monitoring

config NETJSON_MONITORING_IWINFO
	bool "Enable rpcd-mod-iwinfo"
	default y
	help
	  Whether to include the rpcd-mod-iwinfo dependency (enabled by default).

endmenu
```

## admin/rsyslog/Config.in
```kconfig
if PACKAGE_rsyslog
	config RSYSLOG_gssapi_krb5
		bool "Enable GSSAPI Kerberos 5 support"
		default n
		help
		  Enable GSSAPI Kerberos 5 support in rsyslog
	config RSYSLOG_mysql
		bool "Enable MySQL support"
		default n
		help
		  Enable MySQL support in rsyslog
	config RSYSLOG_pgsql
		bool "Enable PostgreSQL support"
		default n
		help
		  Enable PostgreSQL support in rsyslog
	config RSYSLOG_libdbi
		bool "Enable libdbi support"
		default n
		help
		  Enable libdbi support in rsyslog
	config RSYSLOG_elasticsearch
		bool "Enable ElasticSearch module support"
		default n
		help
		  Enable ElasticSearch output module in rsyslog
	config RSYSLOG_omhttp
		bool "Enable HTTP output module support"
		default n
		help
		  Enable HTTP output module in rsyslog
	config RSYSLOG_openssl
		bool "Enable OpenSSL support"
		default n
		help
		  Enable OpenSSL support in rsyslog
	config RSYSLOG_gnutls
		bool "Enable GnuTLS support"
		default n
		help
		  Enable GnuTLS support in rsyslog
	config RSYSLOG_mail
		bool "Enable Mail support"
		default n
		help
		  Enable mail support in rsyslog
	config RSYSLOG_mmjsonparse
		bool "Enable JSON parsing module support"
		default n
		help
		  Enable JSON parsing support in rsyslog
	config RSYSLOG_mmdblookup
		bool "Enable MaxMind DB lookup helper support"
		default n
		help
		  Enable MaxMind DB lookup helper support in rsyslog
	config RSYSLOG_imfile
		bool "Enable file input module support"
		default n
		help
		  Enable input file module in rsyslog
endif
```

## admin/zabbix3/Config.in
```kconfig
menu "Core Zabbix configuration"
	depends on PACKAGE_zabbix3-core

	config ZABBIX3_SSL
        	bool "Enable SSL support"
       		default y

	config ZABBIX3_LUA
        	bool "Enable old agent checks using lua (deprecated)"
       		default n

endmenu
```

## alfred/Config.in
```kconfig
config ALFRED_NEEDS_lua
	bool

config ALFRED_NEEDS_libgps
	bool

config PACKAGE_ALFRED_VIS
	bool "enable vis server for alfred"
	depends on PACKAGE_alfred
	default y

config PACKAGE_ALFRED_BATHOSTS
	bool "enable autogeneration of /etc/bat-hosts"
	depends on PACKAGE_alfred
	select ALFRED_NEEDS_lua
	default n

config PACKAGE_ALFRED_GPSD
	bool "enable gpsd service for alfred"
	depends on PACKAGE_alfred
	select ALFRED_NEEDS_libgps
	default n
```

## batman-adv/Config.in
```kconfig
config KMOD_BATMAN_ADV_DEBUG_LOG
	bool "enable verbose debug logging"
	depends on PACKAGE_kmod-batman-adv
	default n

config KMOD_BATMAN_ADV_BLA
	bool "enable bridge loop avoidance"
	depends on PACKAGE_kmod-batman-adv
	default y

config KMOD_BATMAN_ADV_DAT
	bool "enable distributed arp table"
	depends on PACKAGE_kmod-batman-adv
	default y

config KMOD_BATMAN_ADV_MCAST
	bool "enable multicast transmission optimization"
	depends on PACKAGE_kmod-batman-adv
	default y

config KMOD_BATMAN_ADV_NC
	bool "enable network coding [requires promisc mode support]"
	depends on PACKAGE_kmod-batman-adv
	default n
```

## devel/gcc/Config.in
```kconfig
# gcc library configuration
menu "Libraries"
	depends on PACKAGE_gcc
	config INCLUDE_STATIC_LIBC
		bool "Include static libc on target"
		help
			Copies libc.a to target device
			Increases the size of an already
			very large package
		default n
	config INCLUDE_STATIC_LIBPTHREAD
		bool "Include static libpthread on target"
		help
			Copies libpthread.a to target device
			Increases the size of an already
			very large package
		default n
	config INCLUDE_STATIC_LIBSTDC
		bool "Include static libstdc++ on target"
		help
			Copies libstdc++.a to target device
			Increases the size of an already
			very large package
		default n
	config INCLUDE_STATIC_LINK_SPEC
		depends on INCLUDE_STATIC_LIBSTDC
		bool "Generate spec file for easy static c++ linking on target"
		help
			Creates a spec file for gcc to eliminate the need for
			-lstdc++, -libgcc_pic and -static-libstdc flags when
			statically linking c++ programs
			This doesn't work if the package is built into the
			image, you need to generate the spec file after
			installing the image. For example run:
			g++ -dumpspecs |sed s/--start-group}\ %G\ %L\ /--start-group}\ %G\ %L\ -lstdc++\ -lgcc_pic\ / >/usr/lib/gcc/x86_64-openwrt-linux-musl/7.4.0/specs
			on a x86_64 system
		default n
endmenu
```

## lang/golang/golang-bootstrap/Config.in
```kconfig
menu "Configuration"

config GOLANG_EXTERNAL_BOOTSTRAP_ROOT
	string "External bootstrap Go root directory"
	default ""
	help
	  Path to a working Go tree (>= Go 1.4), with bin, pkg, and src
	  subdirectories and the Go compiler in bin/go.

	  If set, the existing Go installation will be used to compile host
	  (buildroot) Go.

	  Leave blank to compile the default bootstrap Go.

config GOLANG_BUILD_BOOTSTRAP
	bool "Build bootstrap instead of using an external one"
	default y
	help
	  When enabled, build the local bootstrap instead of using an external one
	  for host Go. If 'External bootstrap Go root directory' is set, skip the
	  initial 1.4 step.

	  When disabled, let Go auto-detect the toolchain or use the toolchain
	  specified in 'External bootstrap Go root directory' to skip building the
	  bootstrap and build host Go using that toolchain directly. Configured
	  toolchain must be compatible with the current version of Go.

config GOLANG_BUILD_CACHE_DIR
	string "Go build cache directory"
	default ""
	help
	  Path where Go should store its build cache.

	  If not set, uses '$(TMP_DIR)/go-build'.

config GOLANG_MOD_CACHE_WORLD_READABLE
	bool "Ensure Go module cache is world-readable"
	default n

config GOLANG_SPECTRE
	bool "Enable Spectre mitigations"
	default n
	depends on x86_64
	help
	  Currently only available for x86-64 (amd64).

endmenu
```

## lang/golang/golang/Config.in
```kconfig
menu "Configuration"

config GOLANG_EXTERNAL_BOOTSTRAP_ROOT
	string "External bootstrap Go root directory"
	default ""
	help
	  Path to a working Go tree (>= Go 1.4), with bin, pkg, and src
	  subdirectories and the Go compiler at bin/go.

	  If specified, the existing Go installation will be used to
	  compile host (buildroot) Go.

	  Leave blank to compile the default bootstrap Go.

endmenu
```

## lang/lua-penlight/Config.in
```kconfig
menu "Configuration"
	depends on PACKAGE_lua-penlight

config PENLIGHT_PATHS
	bool
	prompt "Paths, files and directories"
	default n

config PENLIGHT_APPLICATION
	bool
	prompt "Application support"
	default n

config PENLIGHT_STRING
	bool
	prompt "Extra string operations"
	default n

config PENLIGHT_TABLE
	bool
	prompt "Extra table operations"
	default n

config PENLIGHT_ITERATORS
	bool
	prompt "Iterators, OOP and Functional"
	default n

endmenu
```

## lang/node-mozilla-iot-gateway/Config.in
```kconfig
if PACKAGE_node-mozilla-iot-gateway

	comment "Optional features"

	config MOIT_enable-plugin-support
		bool "Enable packages needed for some plugins"
		default y

endif
```

## lang/perl/Config.in
```kconfig
menu "Configuration"
	depends on PACKAGE_perl

config PERL_THREADS
    bool "Enable threading support"
    default y if (mips || mipsel || i386 || i686 || x86_64 || armeb || arm) && (USE_UCLIBC || USE_GLIBC)
    default n

config PERL_TESTS
	bool "Include perl tests"
	default n
	help
		Include test suites for all perl packages.
		
		This will increase the size of perl and related packages
		considerably.
		Test support is still in development. Some tests will fail,
		others are just missing completely.

endmenu
```

## lang/php8/Config.in
```kconfig
menu "Configuration"
	depends on PACKAGE_php8

config PHP8_LIBXML
	bool "Enable LIBXML support"
	default y

config PHP8_DOM
	bool "Enable DOM support"
	select PHP8_LIBXML
	default y
	help
	  Without php8-mod-dom, this option does not provide a PHP8
	  programmer the XML DOM functionality (it only adds DOM for internal
	  use by php-cli, php-cgi, etc.). Therefore please consider adding
	  php8-mod-dom to provide this functionality to PHP8 consumers.

config PHP8_GETTEXT
	bool "Enable gettext support"
	default y
	help
	  Without php8-mod-gettext, this option does not provide a PHP8
	  programmer the gettext functionality (it only adds gettext for internal
	  use by php-cli, php-cgi, etc.). Therefore please consider adding
	  php8-mod-gettext to provide this functionality to PHP8 consumers.

config PHP8_INTL
	bool "Enable Internationalization support"
	default y
	help
	  Note that this option depends in ICU library which is built without data
	  by default. This is to satisfy programs build and run dependencies but to
	  keep the installed footprint small on the target system(s).
	  However, the data is required to make the ICU library useful - and thus
	  directly affects PHPs intl extension, too - so consider to also
	  select PHP8_FULLICUDATA.
	  Without php8-mod-intl, this option does not provide a PHP8
	  programmer the intl functionality (it only adds intl for internal
	  use by php-cli, php-cgi, etc.). Therefore please consider adding
	  php8-mod-intl to provide this functionality to PHP8 consumers.

config PHP8_FULLICUDATA
	bool "Add dependency to full ICU Data"
	default n
	help
	  The ICU library is built without data by default. This is to satisfy
	  programs build and run dependencies but to keep the installed footprint
	  small on the target system(s).
	  However, the data is required to make the ICU library useful - and thus
	  directly affects PHP's intl extension, too.
	  When you do not enable this here, then you can still manually select
	  the package icu-full-data, or install it later.

config PHP8_SYSTEMTZDATA
	bool "Use system timezone data instead of PHP's built-in database"
	depends on PACKAGE_php8-cli || PACKAGE_php8-cgi || PACKAGE_apache-mod-php8
	default y
	help
	  Enabling this feature automatically selects the zoneinfo-core package
	  which contains data for UTC timezone. To use other timezones you have
	  to install the corresponding zoneinfo-... package(s).

endmenu
```

## lang/rust/Config.in
```kconfig
menu "Configuration options (for developers)"

config RUST_SCCACHE
	bool "Use sccache"
	help
	  Shared compilation cache; see https://github.com/mozilla/sccache

config RUST_SCCACHE_DIR
	string "Set sccache directory" if RUST_SCCACHE
	default ""
	help
	  Store sccache in this directory.
	  If not set, uses './.sccache'

endmenu
```

## libs/db47/Config.in
```kconfig
config DB47_ARCHIVE
	bool "Include db_archive"
	depends on PACKAGE_db47-util
	default y

config DB47_CHECKPOINT
	bool "Include db_checkpoint"
	depends on PACKAGE_db47-util
	default y

config DB47_DEADLOCK
	bool "Include db_deadlock"
	depends on PACKAGE_db47-util
	default y

config DB47_DUMP
	bool "Include db_dump"
	depends on PACKAGE_db47-util
	default y

config DB47_HOTBACKUP
	bool "Include db_hotbackup"
	depends on PACKAGE_db47-util
	default y

config DB47_LOAD
	bool "Include db_load"
	depends on PACKAGE_db47-util
        default y

config DB47_PRINTLOG
	bool "Include db_printlog"
	depends on PACKAGE_db47-util
        default y

config DB47_RECOVER
	bool "Include db_recover"
	depends on PACKAGE_db47-util
        default y

config DB47_STAT
	bool "Include db_stat"
	depends on PACKAGE_db47-util
        default y

config DB47_UPGRADE
	bool "Include db_upgrade"
	depends on PACKAGE_db47-util
        default y

config DB47_VERIFY
	bool "Include db_verify"
	depends on PACKAGE_db47-util
        default y
```

## libs/faad2/Config.in
```kconfig
config FAAD2_ALWAYS_USE_FLOATING_POINT
	depends on PACKAGE_libfaad2
	bool "Build FAAD2 to use floating-point math even if using soft floats."
	default n
	help
		By default, libfaad2 will be built to use fixed point rather
		than floating point math if emulated floating point operations
		are being used. (See the CONFIG_SOFT_FLOAT option.) Set this
		option if you would like to use floating point math regardless
		of whether floating point emulation is in use.
		
		For the best real-time decoding ability, leave this option off.
```

## libs/getdns/Config.in
```kconfig
menu "Configuration"
	depends on PACKAGE_getdns

config GETDNS_BUILD_LIBEVENT2
	bool "Use libevent2-based event loop"
	default n
	help
		"Use libevent2 for the event loop (requires libevent2 dependency)."

config GETDNS_ENABLE_STUB_ONLY
	bool "Stub resolution mode only"
	default y
	help
		getdns can be configured for stub resolution mode only (removes libunbound dependency).
	
config GETDNS_ENABLE_IDN_LIBIDN2
	bool "IDN support"
	default n
	help
		getdns can be configured with some IDN Support (requires libidn2 dependency).

endmenu
```

## libs/gnutls/Config.in
```kconfig
# gnutls avanced configuration

menu "Configuration"
	depends on PACKAGE_libgnutls

config GNUTLS_DTLS_SRTP
	bool "enable DTLS SRTP support"

config GNUTLS_ALPN
	bool "enable ALPN support"

config GNUTLS_OCSP
	bool "enable ocsp support"

config GNUTLS_CRYPTODEV
	bool "enable /dev/crypto support"
	depends on BROKEN

config GNUTLS_HEARTBEAT
	bool "enable DTLS heartbeat support"

config GNUTLS_OPENPGP
	bool "enable OPENPGP authentication support"

config GNUTLS_SRP
	bool "enable SRP authentication support"

config GNUTLS_PSK
	bool "enable PSK authentication support"

config GNUTLS_ANON
	bool "enable anonymous authentication support"

config GNUTLS_PKCS11
	bool "enable smart card (PKCS11) support"
	select GNUTLS_EXT_LIBTASN1
	default n

config GNUTLS_EXT_LIBTASN1
	bool "use external libtasn1"
	default n

endmenu
```

## libs/libdrm/Config.in
```kconfig
menu "Select libdrm build options"
		depends on PACKAGE_libdrm

config LIBDRM_INTEL
	bool "Intel support"
	default n
	depends on x86_64 || i386
	help
		Installs the Intel driver.

endmenu
```

## libs/libjcat/Config.in
```kconfig
menu "Select libjcat options"
	depends on PACKAGE_libjcat

config LIBJCAT_CLI
	bool "Command-line tool"
	default n
	help
	  Compile and install the libjcat cli tool

config LIBJCAT_GPG
	bool "GPG"
	default y
	help
	  Compile libjcat with GPG support

config LIBJCAT_PKCS7
	bool "PKCS #7"
	default y
	help
	  Compile libjcat with PKCS #7 support

config LIBJCAT_ED25519
	bool "ed25519"
	default y
	help
	  Compile libjcat with ed25519 support

endmenu
```
