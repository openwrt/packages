## net/eds-kubelet/Config.in
```kconfig
config EDGESCALE_KUBELET_KERNEL_SUPPORT
	bool "Kernel support for Edgescale Kubelet"
	depends on PACKAGE_edgescale-kubelet
	select KERNEL_NAMESPACES
	select KERNEL_NET_NS
	select KERNEL_PID_NS
	select KERNEL_IPC_NS
	select KERNEL_UTS_NS
	select KERNEL_CGROUPS
	select KERNEL_CGROUP_CPUACCT
	select KERNEL_CGROUP_DEVICE
	select KERNEL_CGROUP_FREEZER
	select KERNEL_CGROUP_SCHED
	select KERNEL_CPUSETS
	select KERNEL_MEMCG
	select KERNEL_KEYS
	select KERNEL_LXC_MISC
	select KERNEL_POSIX_MQUEUE
	default y
	help
	  This enables kerenl options required by Edgescale Kubelet.
```

## net/eds/Config.in
```kconfig
config EDGESCALE_BUSYBOX_SUPPORT
	bool "Busybox support for Edgescale"
	depends on PACKAGE_edgescale
	select BUSYBOX_CUSTOM
	select BUSYBOX_CONFIG_HOSTNAME
	default y
	help
	  This enables Busybox options required by Edgescale.

config EDGESCALE_KERNEL_SUPPORT
	bool "Kernel support for Edgescale"
	depends on PACKAGE_edgescale
	select KERNEL_DEVMEM
	default y
	help
	  This enables kerenl options required by Edgescale.
```

## net/ethtool/Config.in
```kconfig
menu "Configuration"
	depends on PACKAGE_ethtool

	config ETHTOOL_PRETTY_DUMP
		bool "Enable pretty printing"

endmenu
```

## net/fastd/Config.in
```kconfig
if PACKAGE_fastd

menu "Configuration"

config FASTD_ENABLE_METHOD_CIPHER_TEST
	bool "Enable cipher-test method provider"

config FASTD_ENABLE_METHOD_COMPOSED_GMAC
	bool "Enable composed-gmac method provider"
	select FASTD_ENABLE_MAC_GHASH

config FASTD_ENABLE_METHOD_COMPOSED_UMAC
	bool "Enable composed-umac method provider"
	select FASTD_ENABLE_MAC_UHASH
	default y

config FASTD_ENABLE_METHOD_GENERIC_GMAC
	bool "Enable generic-gmac method provider"
	select FASTD_ENABLE_MAC_GHASH

config FASTD_ENABLE_METHOD_GENERIC_POLY1305
	bool "Enable generic-poly1305 method provider"

config FASTD_ENABLE_METHOD_GENERIC_UMAC
	bool "Enable generic-umac method provider"
	select FASTD_ENABLE_MAC_UHASH
	default y

config FASTD_ENABLE_METHOD_NULL
	bool "Enable null method"
	default y

config FASTD_ENABLE_METHOD_NULL_L2TP
	bool "Enable null@l2tp method"
	default y


config FASTD_ENABLE_CIPHER_NULL
	bool "Enable the null cipher"
	default y

config FASTD_ENABLE_CIPHER_SALSA20
	bool "Enable the Salsa20 cipher"

config FASTD_ENABLE_CIPHER_SALSA2012
	bool "Enable the Salsa20/12 cipher"
	default y


config FASTD_ENABLE_MAC_GHASH
	bool

config FASTD_ENABLE_MAC_UHASH
	bool


config FASTD_WITH_CAPABILITIES
	bool "Enable POSIX capability support"

config FASTD_WITH_CMDLINE_USER
	bool "Include support for setting user/group related options on the command line"

config FASTD_WITH_CMDLINE_LOGGING
	bool "Include support for setting logging related options on the command line"

config FASTD_WITH_CMDLINE_OPERATION
	bool "Include support for setting options related to the VPN operation (like mode, interface, encryption method) on the command line"

config FASTD_WITH_CMDLINE_COMMANDS
	bool "Include support for setting handler scripts (e.g. --on-up) on the command line"

config FASTD_WITH_DYNAMIC_PEERS
	bool "Include support for dynamic peers (using on-verify handlers)"

config FASTD_WITH_STATUS_SOCKET
	bool "Include support for status sockets"
	default y

config FASTD_WITH_OFFLOAD_L2TP
	bool "Enable L2TP offloading"
	default y

endmenu

endif
```

## net/freeradius2/Config.in
```kconfig
# FreeRADIUS avanced configuration

choice
	prompt "SSL library"
	default FREERADIUS_OPENSSL
	depends on PACKAGE_freeradius2-common

config FREERADIUS_NOSSL
	bool "No SSL support"

config FREERADIUS_OPENSSL
	bool "OpenSSL"

endchoice
```

## net/frr/Config.in
```kconfig
if PACKAGE_frr
comment "SSL support"

choice
        prompt "Selected SSL MD5 library"
        default FRR_INTERNAL

        config FRR_OPENSSL
                bool "OpenSSL"

        config FRR_INTERNAL
                bool "internal SSL support"
endchoice

comment "Packages"

endif
```
