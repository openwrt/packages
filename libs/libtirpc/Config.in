## libs/libtirpc/Config.in
```kconfig
menu "Configuration"
	depends on PACKAGE_libtirpc

	config LIBTIRPC_GSSAPI
		bool
		prompt "Enable GSSAPI support"
		help
			Enable this switch if you have a GSSAPI installed and you wish to use it.
		default n

		menu "GSSAPI selector"
			depends on PACKAGE_libtirpc

			config LIBTIRPC_KRB5
				depends on LIBTIRPC_GSSAPI
				bool
				prompt "Enable KRB5's GSSAPI support"
				help
					Enable this switch if you have KRB5 installed and you wish to use it.
				default y

		endmenu

endmenu
```

## libs/libxmlb/Config.in
```kconfig
menu "Select libxmlb options"
	depends on PACKAGE_libxmlb

config LIBXMLB_CLI
	bool "Command-line tool"
	default n
	help
	  Compile and install the xb-tool cli

config LIBXMLB_LZMA
	bool "LZMA"
	default n
	help
	  Compile libxmlb with LZMA support

config LIBXMLB_ZSTD
	bool "zstd"
	default n
	help
	  Compile libxmlb with zstd support

endmenu
```

## libs/openldap/Config.in
```kconfig
if PACKAGE_libopenldap
	config OPENLDAP_DEBUG
		bool "Enable debugging information"
		default y
		help
		  Enable debugging information. This option must be enabled
		  for the loglevel directive to work.
	config OPENLDAP_CRYPT
		bool "Crypt(3) passwords support"
		default n
		help
		  With crypt(3) password storage scheme enabled, OpenLDAP can
		  receive and store SHA-256 and SHA-512 password hashes from
		  Samba AD-DC. If this option is disabled, synchronization of
		  passwords between Samba AD-DC (v4.5 and above) and OpenLDAP
		  requires use of cleartext passwords.
		  To enable crypt(3) password synchronization functionality:
		  1. Re-include crypt(3) support in OpenWRT by enabling 'Include
		  crypt() support for SHA256, SHA512 and Blowfish ciphers' option
		  in "Advanced configuration options (for developers)" ->
		  "Toolchain Options".
		  2. Provision AD-DC with 'password hash userPassword schemes'
		  option. For more information, see smb.conf manpage for details
		  on 'password hash userPassword schemes'.
		  3. Use a script to synchronize passwords from AD-DC to
		  OpenLDAP. See samba-tool manpage for 'user syncpasswords'.
	config OPENLDAP_MONITOR
		bool "Enable monitor backend"
		default n
		help
		  Enable monitor backend to obtain information about the running
		  status of the daemon. See OpenLDAP documentation for more
		  information.
	config OPENLDAP_DB47
		bool "Berkeley DB support"
		default n
		help
		  Enable Berkeley DB support (BDB).
	config OPENLDAP_ICU
		bool "ICU support"
		default n
		help
		  Enable ICU (International Components for Unicode) support.
endif
```

## libs/qtbase/Config.in
```kconfig
choice
	prompt "Build Variant"
	default QT_BUILD_RELEASE
	help
		Choose which Qt variant should be built:
		-> Release: Build Qt with debugging turned off.
		-> Debug: Build Qt with debugging turned on.

	config QT_BUILD_RELEASE
		bool "Release"

	config QT_BUILD_DEBUG
		bool "Debug"
endchoice

config QT_OPTIMIZE_SIZE
	depends on QT_BUILD_RELEASE
	bool "Optimize Size"
	default n
	help
		Optimize release builds for size instead of speed.
		(Not available in debug variant)

config QT_OPTIMIZE_DEBUG
	depends on QT_BUILD_DEBUG
	bool "Optimize Debug"
	default n
	help
		Enable debug-friendly optimizations in debug builds.
		(Not available in release variant)

config QT_OPTIMIZE_TOOLS
	depends on QT_BUILD_DEBUG
	bool "Optimized Tools"
	default n
	help
		Build optimized host tools even in debug build.
```

## libs/sqlite3/Config.in
```kconfig
menu "Configuration"
	depends on PACKAGE_libsqlite3

config SQLITE_FTS3
	bool
	prompt	"Enable FTS3"
	help
		"Enable support for full-text search version 3"
	default y

config SQLITE_RTREE
	bool
	prompt	"Enable RTREE"
	help
		"Enable support for the R*Tree index extension"
	default y

endmenu
```

## libs/srt/Config.in
```kconfig
if PACKAGE_srt

comment "Encryption support"

choice
	prompt "Selected Encryption library"
	default SRT_OPENSSL

	config SRT_OPENSSL
		bool "OpenSSL"

	config SRT_MBEDTLS
		bool "mbed TLS"

	config SRT_GNUTLS
		bool "GNUTLS"

	config SRT_NOENCRYPTION
		bool "No encryption support"

endchoice

comment "Options"

config SRT_MONOTONIC_CLOCK
	bool "Monotonic clock"
	default y

config SRT_BONDING
	bool "Bonding"
	default n

endif
```

## libs/xmlrpc-c/Config.in
```kconfig
# xmlrpc-c configuration
menu "Configuration"
	depends on PACKAGE_xmlrpc-c

comment "XML backend"

choice
	prompt "Selected XML backend"
	default XMLRPC_C_INTERNAL

	config XMLRPC_C_INTERNAL
		bool "Internal"

	config XMLRPC_C_LIBXML2
		bool "libxml2"

endchoice

comment "Features"

config XMLRPC_C_CLIENT
	bool "XMLRPC client"
	default n

config XMLRPC_C_SERVER
	bool "XMLRPC server"
	default y

endmenu
```

## mail/emailrelay/Config.in
```kconfig
if PACKAGE_emailrelay

comment "SSL support (SSMTP is supported)"

choice
	prompt "Select TSL library"
	default EMAILRELAY_SSL

	config EMAILRELAY_SSL
		bool "OpenSSL"
		select PACKAGE_libopenssl
		help
			Builds the package with OpenSSL.

	config EMAILRELAY_SSL_MBEDTLS
		bool "MbedTLS"
		select PACKAGE_libmbedtls
		select MBEDTLS_DEBUG_C
		select MBEDTLS_VERSION_C
		select MBEDTLS_VERSION_FEATURES
		select MBEDTLS_SSL_RENEGOTIATION
		help
			Builds the package with MbedTLS.

	config EMAILRELAY_NOSSL
		bool "No TLS support"
endchoice

config EMAILRELAY_SUPPORT_VERBOSE_DBG
	bool "Enable support for extended logging"
	default n
	help
		Enables support for extended logging (must also be explicitly enabled by using command line switch --debug when starting emailrelay)

endif
```

## mail/mutt/Config.in
```kconfig
if PACKAGE_mutt
	config MUTT_POP
		bool "POP support"
		default y
		help
		  Enables POP support in mutt.
	config MUTT_IMAP
		bool "IMAP support"
		default y
		help
		  Enables IMAP support in mutt.
	config MUTT_SMTP
		bool "SMTP support"
		default n
		help
		  Enables SMTP support in mutt.
	config MUTT_HCACHE
		bool "Header caching support"
		default n
		help
		  Enables header caching support in mutt (using libgdbm).
	config MUTT_SASL
		bool "SASL support"
		default n
		help
		  Enables SASL support in mutt (libsasl2).
	config MUTT_GNUTLS
		bool "GnuTLS support"
		default n
		help
		  Enables GnuTLS support in mutt (libgnutls).
	config MUTT_OPENSSL
		bool "OpenSSL support"
		default y
		help
		  Enables OpenSSL support in mutt (libopenssl).
endif
```

## multimedia/ffmpeg4/Config.in
```kconfig
if PACKAGE_ffmpeg4

menu "Configuration"

config ffmpeg4_LICENSING
  bool "See help for licensing information"
  help
	Short version:
	Default license is GNU Lesser General Public License v2.1 or later

	Following changes it to GPL:
	Building it for x86 due to assembly files
	Support for libx264

	Following changes it to version 3:
	Support for mbed TLS

	Following makes it non distributable and requires
	"Compile with support for patented functionality"
	to be set.
	Support for FDK-AAC and OpenSSL

	More information here:
	https://github.com/FFmpeg/FFmpeg/blob/master/LICENSE.md
  default n

config ffmpeg4_ENC_FLV
  bool "Enable builtin FLV encoder"
  default y if !mips && !mipsel && !mips64

config ffmpeg4_ENC_MJPEG
  bool "Enable builtin MJPEG encoder"
  default y if !mips && !mipsel && !mips64

config ffmpeg4_ENC_MPEG4
  bool "Enable builtin MPEG4 encoder"
  default y if !mips && !mipsel && !mips64

config ffmpeg4_ENC_PNG
  bool "Enable builtin PNG encoder"
  default n

config ffmpeg4_FEAT_DASH
  bool "Enable support for Dynamic Adaptive Streaming over HTTP (DASH)"
  default y

config ffmpeg4_LIB_FDK-AAC
  bool "Enable FDK-AAC (AAC encoding) support"
  default n

config ffmpeg4_LIB_LAME
  bool "Enable LAME (MP3 encoding) support"
  default y if !mips && !mipsel && !mips64

config ffmpeg4_LIB_LIBVORBIS
  bool "Enable Ogg Vorbis (de/encoding) support using libvorbis"
  default n

config ffmpeg4_LIB_LIBOPUS
  bool "Enable Opus (de/encoding) support using libopus"
  default n

config ffmpeg4_LIB_LIBX264
  bool "Enable x264 (h264 encoding) support"
  default n

config ffmpeg4_OPT_PERFORMANCE
  bool "Optimize for performance"
  default y if !mips && !mipsel && !mips64

endmenu

choice

  prompt "SSL Library"
  default ffmpeg4_LIB_MBEDTLS

config ffmpeg4_LIB_MBEDTLS
  bool "mbed TLS"

config ffmpeg4_LIB_OPENSSL
  bool "OpenSSL"

endchoice

endif
```

## multimedia/mjpg-streamer/Config.in
```kconfig
#
# Copyright (C) 2014 OpenWrt.org
#

if PACKAGE_mjpg-streamer

config MJPG_STREAMER_V4L2
	bool "Build input_uvc with libv4l2 (camera controls)"
	default n
	select PACKAGE_libv4l

config MJPG_STREAMER_INPUT_FILE
	bool "Install input file plugin"
	default n

config MJPG_STREAMER_INPUT_UVC
	bool "Install input uvc plugin"
	default y

config MJPG_STREAMER_INPUT_HTTP
	bool "Install input HTTP plugin"
	default n

config MJPG_STREAMER_OUTPUT_RTSP
	bool "Install output RTSP plugin"
	default n

config MJPG_STREAMER_OUTPUT_UDP
	bool "Install output UDP plugin"
	default n

config MJPG_STREAMER_OUTPUT_FILE
	bool "Install output file plugin"
	default n

config MJPG_STREAMER_OUTPUT_HTTP
	bool "Install output HTTP plugin"
	default y

config MJPG_STREAMER_WWW
	bool "Install complete Web UI files (includes cambozola)"
	default n

endif
```
