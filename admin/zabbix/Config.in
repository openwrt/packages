## net/coredns/Config.in
```kconfig
if PACKAGE_coredns

comment "Transport & Security"

config COREDNS_PLUGIN_TLS
	bool "TLS plugin"
	default y
	help
	  Enable TLS (DNS-over-TLS) listener support.

config COREDNS_PLUGIN_QUIC
	bool "QUIC plugin (DNS-over-QUIC)"
	default n
	help
	  Enable DNS-over-QUIC (DoQ) listener support. Requires TLS certificates.

config COREDNS_PLUGIN_GRPC
	bool "gRPC plugin"
	default n
	help
	  Forward or receive DNS messages over gRPC.

config COREDNS_PLUGIN_PROXYPROTO
	bool "Proxy Protocol plugin"
	default n
	help
	  Add PROXY protocol (v1/v2) support to preserve original client IPs
	  when CoreDNS sits behind a load balancer or reverse proxy.

comment "Service Discovery Backends"

config COREDNS_PLUGIN_KUBERNETES
	bool "Kubernetes plugin"
	default n
	help
	  Serve DNS records for Kubernetes services and pods.
	  Only useful when running inside a Kubernetes cluster.

config COREDNS_PLUGIN_K8S_EXTERNAL
	bool "k8s_external plugin"
	default n
	help
	  Serve DNS records for external-facing Kubernetes services
	  (e.g. LoadBalancer / ExternalName).

config COREDNS_PLUGIN_ETCD
	bool "Etcd plugin"
	default n
	help
	  Serve DNS records from an etcd v3 datastore (SkyDNS-compatible).

config COREDNS_PLUGIN_NOMAD
	bool "Nomad plugin"
	default n
	help
	  Serve DNS records from HashiCorp Nomad service registrations.

comment "Cloud DNS Backends"

config COREDNS_PLUGIN_ROUTE53
	bool "Route53 plugin (AWS)"
	default n
	help
	  Serve DNS records from AWS Route 53 hosted zones.
	  Adds significant binary size due to AWS SDK.

config COREDNS_PLUGIN_AZURE
	bool "Azure DNS plugin"
	default n
	help
	  Serve DNS records from Azure DNS hosted zones.
	  Adds significant binary size due to Azure SDK.

config COREDNS_PLUGIN_CLOUDDNS
	bool "Cloud DNS plugin (GCP)"
	default n
	help
	  Serve DNS records from Google Cloud DNS managed zones.
	  Adds significant binary size due to GCP SDK.

comment "Extra Built-in Plugins"

config COREDNS_PLUGIN_GEOIP
	bool "GeoIP plugin"
	default n
	help
	  Add GeoIP-based metadata to requests (requires MaxMind database).

config COREDNS_PLUGIN_ON
	bool "On-event plugin"
	default n
	help
	  Execute a command on server start/shutdown events.

config COREDNS_PLUGIN_SIIT
	bool "SIIT plugin"
	default n
	help
	  Synthesize A records from AAAA records within a SIIT prefix
	  (IPv6->IPv4 translation, RFC 6052 / RFC 7757 EAM).

config COREDNS_PLUGIN_DYNUPDATE
	bool "Dynamic update plugin"
	default n
	help
	  Accept TSIG-authenticated RFC 2136 DNS UPDATE messages for an
	  opt-in authoritative zone, optionally persisted in a local bbolt
	  database. Experimental.

comment "Third-party Plugins"

config COREDNS_PLUGIN_WGSD
	bool "WireGuard Service Discovery plugin"
	default y if PACKAGE_wgsd-coredns
	select COREDNS_REQUIRE_GO_GET
	help
	  wgsd serves WireGuard peer information via DNS-SD (RFC 6763)
	  semantics. Use cases include:
	   - Building a mesh of WireGuard peers from a central registry
	   - Dynamic discovery of WireGuard endpoint addressing
	   - NAT-to-NAT connectivity where UDP hole punching is supported

config COREDNS_PLUGIN_NETBOX
	bool "Netbox plugin"
	default n
	select COREDNS_REQUIRE_GO_GET
	help
	  Serve DNS records from a NetBox IPAM/DCIM instance.

config COREDNS_PLUGIN_GSLB
	bool "GSLB plugin"
	default n
	select COREDNS_REQUIRE_GO_GET
	help
	  CoreDNS-GSLB adds Global Server Load Balancing to CoreDNS for
	  non-Kubernetes infrastructures (VMs, bare metal, hybrid cloud).
	  Features: health monitoring (HTTP/S, TCP, ICMP, MySQL, gRPC, Lua),
	  GeoIP and weighted/round-robin/IP-hash selection, failover policies,
	  live config reload, REST API, Prometheus metrics and optional
	  Redis-backed HA synchronization.

config COREDNS_PLUGIN_MULTICLUSTER
	bool "Multicluster plugin"
	default n
	select COREDNS_REQUIRE_GO_GET
	help
	  Implementation of the Kubernetes DNS-Based Multicluster Service
	  Discovery Specification (clusterset.local). Adds a large
	  k8s.io/client-go dependency tree and is only useful when
	  querying remote Kubernetes clusters.

config COREDNS_PLUGIN_FANOUT
	bool "Fanout plugin"
	default n
	select COREDNS_REQUIRE_GO_GET
	help
	  Forward DNS queries to multiple upstreams simultaneously and return
	  the first successful response (race / fan-out strategy).

config COREDNS_PLUGIN_FINALIZE
	bool "Finalize plugin"
	default n
	select COREDNS_REQUIRE_GO_GET
	help
	  Ensure all CNAME chains in responses are fully resolved before
	  sending the answer to the client.

config COREDNS_REQUIRE_GO_GET
	bool
	default n
	help
	  Custom / third-party plugins require 'go get ./...' during build
	  to pull their module dependencies.

endif
```

## net/weechat/Config.in
```kconfig
menu "Configuration"
	depends on PACKAGE_weechat-full || PACKAGE_weechat-minimal

config WEECHAT_ZSTD
	bool "Enable Zstandard compression"
	default y
	help
	  Enable Zstandard compression support for WeeChat (used in relay protocol and logs).

config WEECHAT_CJSON
	bool "Enable cJSON support"
	default n
	help
	  Enable cJSON library support for WeeChat JSON processing.

config WEECHAT_PYTHON
	bool "Enable Python scripting plugin"
	default n
	help
	  Enable Python 3 scripting plugin for WeeChat.

config WEECHAT_LUA
	bool "Enable Lua scripting plugin"
	default n
	help
	  Enable Lua scripting plugin for WeeChat.

config WEECHAT_RUBY
	bool "Enable Ruby scripting plugin"
	default n
	help
	  Enable Ruby scripting plugin for WeeChat.

config WEECHAT_PERL
	bool "Enable Perl scripting plugin"
	default n
	help
	  Enable Perl scripting plugin for WeeChat.

config WEECHAT_TCL
	bool "Enable Tcl scripting plugin"
	default n
	help
	  Enable Tcl scripting plugin for WeeChat.

endmenu
```

## utils/lpac/Config.in
```kconfig
menu "Configuration"

config LPAC_WITH_PCSC
	bool "Include APDU PCSC Backend support"
	default y
	help
	  Compile LPAC with APDU PCSC Backend support.

config LPAC_WITH_AT
	bool "Include APDU AT Backend support"
	default y
	help
	  Compile LPAC with APDU AT Backend support.

config LPAC_WITH_UQMI
	bool "Include APDU uqmi Backend support"
	default y
	help
	  Compile LPAC with APDU uqmi Backend support.

config LPAC_WITH_MBIM
	bool "Include APDU MBIM Backend support"
	default y
	help
	  Compile LPAC with APDU MBIM Backend support.

config LPAC_WITH_QMI
	bool "Include APDU QMI Backend support"
	default y
	help
	  Compile LPAC with APDU QMI Backend support.

config LPAC_INSTALL_GSMA_CI_CERTS
	bool "Download GSMA RSP Root CI certificates and add them to the system CA bundle"
	default y
	select PACKAGE_ca-bundle
	help
	  Downloads the following three GSMA "Root Certificate Issuer for
	  Remote SIM Provisioning" root certificates at build time and
	  merges them into /etc/ssl/certs/ca-certificates.crt. This allows
	  lpac (and any other tool relying on the system CA bundle, e.g.
	  curl) to validate TLS connections to SM-DP+/SM-DS servers.

	  Source of this certificate list:
	  https://www.gsma.com/solutions-and-impact/technologies/internet-of-things/embedded-sim/gsma-root-certificate-issuer-remote-sim-provisioning/ :

	    - Verizon/M2M31 Root CI (DER, M2M variant):
	      https://www.gsma.com/solutions-and-impact/technologies/internet-of-things/wp-content/uploads/2017/03/Verizon_GSMA_M2M31-Root-CI21.crt_.txt

	    - Symantec/RSPv2 Root CI (PEM, Consumer variant):
	      https://www.gsma.com/solutions-and-impact/technologies/internet-of-things/wp-content/uploads/2017/03/Symantec_GSMA_RSPv2-Root-CI1.txt

	    - CI SIG OISTE (PEM, eSIM IoT variant, shipped as a .zip):
	      https://www.gsma.com/solutions-and-impact/technologies/esim/wp-content/uploads/2024/01/CERT_CI_SIG_OISTE.pem_.zip

	  All three are fetched, normalized to PEM (converting the DER
	  file and unpacking the zip as needed) and appended to the CA
	  bundle.
endmenu
```
