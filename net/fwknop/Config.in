## net/fwknop/Config.in
```kconfig
#fwknop config
menu "Configuration"
	depends on PACKAGE_fwknopd

config FWKNOPD_GPG
	bool "Enable GPG support"
	select PACKAGE_gnupg
	default n



endmenu
```

## net/gensio/Config.in
```kconfig
	config GENSIO_SSL
		depends on PACKAGE_libgensio
		bool "Enable SSL-support via OpenSSL"
		default n

	config GENSIO_WRAP
		depends on PACKAGE_libgensio
		bool "Build with libwrap"
		default n

	config GENSIO_SCTP
		depends on PACKAGE_libgensio && IPV6
		bool "Enable SCTP-support via libsctp"
		default n

	config GENSIO_PTHREADS
		depends on PACKAGE_libgensio
		bool "Enable pthreads"
		default y

	config GENSIO_AVAHI
		depends on PACKAGE_libgensio
		bool "Enable mDNS via Avahi"
		default n

	config GENSIO_GLIB
		depends on PACKAGE_libgensio
		bool "Build with glib2"
		default n

	config GENSIO_TCL
		depends on PACKAGE_libgensio
		bool "Build with tcl"
		default n
```

## net/modemmanager/Config.in
```kconfig
menu "Configuration"
	depends on PACKAGE_modemmanager

config MODEMMANAGER_WITH_MBIM
	bool "Include MBIM support"
	default y
	help
	  Compile ModemManager with MBIM support

config MODEMMANAGER_WITH_QMI
	bool "Include QMI support"
	default y
	help
	  Compile ModemManager with QMI support

config MODEMMANAGER_WITH_QRTR
	bool "Include QRTR support"
	default y
	depends on MODEMMANAGER_WITH_QMI
	select LIBQMI_WITH_QRTR_GLIB
	help
	  Compile ModemManager with QRTR support

config MODEMMANAGER_WITH_AT_COMMAND_VIA_DBUS
	bool "Allow AT commands via DBus"
	default n
	help
	  Compile ModemManager allowing AT commands without debug flag

endmenu
```

## net/mosquitto/Config.in
```kconfig
config MOSQUITTO_LWS
    bool "libwebsockets support"
    depends on PACKAGE_mosquitto-ssl
    default y
    help
        Includes websockets support in the broker, via libwebsockets

config MOSQUITTO_PASSWD
    bool "Include mosquitto_passwd utility"
    depends on PACKAGE_mosquitto-ssl
    default y
    help
        mosquitto_passwd is a tool for managing password files for mosquitto.

config MOSQUITTO_SRV
    bool "Include SRV lookup support"
    depends on PACKAGE_libmosquitto || PACKAGE_libmosquitto-nossl || PACKAGE_mosquitto-client || PACKAGE_mosquitto-client-nossl
    select PACKAGE_libcares
    default y
    help
        Support DNS SRV lookups to determine which host to connect to.
```

## net/net-snmp/Config.in
```kconfig
if PACKAGE_net-snmp-ssl
	menu "Configuration"
		depends on PACKAGE_net-snmp-ssl

		config NETSNMP_WITH_OPENSSL
			bool
			default y
			prompt "Enable compilation with OPENSSL"
	endmenu
endif
```

## net/netatalk/Config.in
```kconfig
if PACKAGE_netatalk-full

	config PACKAGE_NETATALK_APPLETALK
		bool "Enable AppleTalk support."
		default y

	config PACKAGE_NETATALK_ZEROCONF
		bool "Enable Zeroconf support."
		default y

	config PACKAGE_NETATALK_ACLS
		bool "Enable ACL support."
		default y

	config PACKAGE_NETATALK_PAM
		bool "Enable PAM support."
		default y

	config PACKAGE_NETATALK_LDAP
		bool "Enable LDAP support."
		default y

	config PACKAGE_NETATALK_ICONV
		bool "Use libiconv features."
		default y

	config PACKAGE_NETATALK_KERBEROS
		bool "Enable kerberos support."
		default y

	config PACKAGE_NETATALK_LIBWRAP
		bool "Enable TCP wrappers."
		default y

	choice
		prompt "CNID backends"
		default PACKAGE_NETATALK_BOTHBACK

		config PACKAGE_NETATALK_DBDBACK
			bool "dbd"

		config PACKAGE_NETATALK_SQLITEBACK
			bool "sqlite"

		config PACKAGE_NETATALK_BOTHBACK
			bool "dbd,sqlite"
	endchoice

endif
```

## net/netifyd/Config.in
```kconfig
menu "Configuration"
	depends on PACKAGE_netifyd

config NETIFYD_BUILD_SHARED_LIBRARY
	bool "Build the Agent as a shared library?"
	default y
	help
		Build the Agent as a shared library when enabled, or statically link it otherwise.  Statically linking can make debugging easier.

config NETIFYD_WITH_LOCAL_LIBGCRYPT
	bool "Link nDPI with the local system libgcrypt?"
	default y
	help
		Link the Agent (and nDPI) against the local system libgcrypt, or use the bundled gcrypt lite version.

endmenu
```

## net/nfs-kernel-server/Config.in
```kconfig
menu "Select nfs-kernel-server configuration options"
        depends on PACKAGE_nfs-kernel-server

config NFS_KERNEL_SERVER_V4
	bool "Include support for NFSv4"
	default y

config CONFIG_NFSD_LEGACY_CLIENT_TRACKING
	bool "Store client tracking statefully in /proc/fs/nfsd/nfsv4recoverydir"
	default y
endmenu
```

## net/nginx/Config.in
```kconfig
#
# Copyright (C) 2010-2012 OpenWrt.org
#
# This is free software, licensed under the GNU General Public License v2.
# See /LICENSE for more information.
#

menu "Configuration"
        depends on PACKAGE_nginx

config NGINX_STUB_STATUS
	bool
	prompt "Enable stub status module"
	help
		Enable the stub status module which gives some status from the server.

config NGINX_FLV
	bool
	prompt "Enable FLV module"
	help
		Provides the ability to seek within FLV (Flash) files using time-based offsets.

config NGINX_SSL
	bool
	prompt "Enable SSL module"
	help
		Enable HTTPS/SSL support.

config NGINX_DAV
	bool
	prompt "Enable WebDAV module"
	help
		Enable the HTTP and WebDAV methods PUT, DELETE, MKCOL, COPY and MOVE.

config NGINX_LUA
	bool
	prompt "Enable LUA module"
	help
		Enable support for LUA scripts.

config NGINX_PCRE
	bool
	prompt "Enable PCRE library usage"
	default y

config NGINX_HTTP_CACHE
	bool
	prompt "Enable HTTP cache"

config NGINX_HTTP_CHARSET
	bool
	prompt "Enable HTTP charset module"
	default y

config NGINX_HTTP_GZIP
	bool
	prompt "Enable HTTP gzip module"
	default y

config NGINX_HTTP_SSI
	bool
	prompt "Enable HTTP ssi module"
	default y

config NGINX_HTTP_USERID
	bool
	prompt "Enable HTTP userid module"
	default y

config NGINX_HTTP_ACCESS
	bool
	prompt "Enable HTTP access module"
	default y

config NGINX_HTTP_AUTH_BASIC
	bool
	prompt "Enable HTTP auth basic"
	default y

config NGINX_HTTP_AUTOINDEX
	bool
	prompt "Enable HTTP autoindex module"
	default y

config NGINX_HTTP_GEO
	bool
	prompt "Enable HTTP geo module"
	default y

config NGINX_HTTP_MAP
	bool
	prompt "Enable HTTP map module"
	default y

config NGINX_HTTP_SPLIT_CLIENTS
	bool
	prompt "Enable HTTP split clients"
	default y

config NGINX_HTTP_REFERER
	bool
	prompt "Enable HTTP referer module"
	default y

config NGINX_HTTP_REWRITE
	bool
	prompt "Enable HTTP rewrite module"
	select NGINX_PCRE
	default y

config NGINX_HTTP_PROXY
	bool
	prompt "Enable HTTP proxy module"
	default y

config NGINX_HTTP_FASTCGI
	bool
	prompt "Enable HTTP fastcgi module"
	default y

config NGINX_HTTP_UWSGI
	bool
	prompt "Enable HTTP uwsgi module"
	default y

config NGINX_HTTP_SCGI
	bool
	prompt "Enable HTTP scgi module"
	default y

config NGINX_HTTP_MEMCACHED
	bool
	prompt "Enable HTTP memcached module"
	default y

config NGINX_HTTP_LIMIT_CONN
	bool
	prompt "Enable HTTP limit conn"
	default y

config NGINX_HTTP_LIMIT_REQ
	bool
	prompt "Enable HTTP limit req"
	default y

config NGINX_HTTP_EMPTY_GIF
	bool
	prompt "Enable HTTP empty gif"
	default y

config NGINX_HTTP_BROWSER
	bool
	prompt "Enable HTTP browser module"
	default y

config NGINX_HTTP_UPSTREAM_IP_HASH
	bool
	prompt "Enable HTTP IP hash module"
	default y

config NGINX_NAXSI
	bool
	prompt "Enable NAXSI module"
	select PACKAGE_nginx-naxsi
	default y
	help
		Enable support for NAXSI WAF.

config NGINX_PROXYPROTOCOL
	bool
	prompt "Enable HAProxy proxyprotocol"
	select PACKAGE_nginx-proxyprotocol
	select NGINX_SSL
	default n
	help
		Enable support for PROXY PROTOCOL

config NGINX_SYSLOG
	bool
	prompt "Enable Syslog module"
	select PACKAGE_nginx-syslog
	default y
	help
		Provides the ability log to a remote destination

config NGINX_HTTP_UPSTREAM_CHECK
	bool
	select NGINX_SSL
	prompt "Enable HTTP upstream check module"
	default n

endmenu
```

## net/nut/Config.in
```kconfig
	config NUT_SSL
		depends on PACKAGE_nut && !NUT_SSL_NSS
		bool "Build with support for OpenSSL"
		help
			SSL allows sessions between upsd and clients to be encrypted and can
			also be used to authenticate servers. This means that stealing port
			3493 from upsd will no longer net you interesting passwords. SSL is
			available via OpenSSL on OpenWrt. If you are happy with using passwords
			to authenticate clients, you can save some space and build NUT without
			SSL support. Defaults to n due to licensing (NUT is GPL with no OpenSSL
			exception).
		default n

	config NUT_SSL_NSS
		depends on PACKAGE_nut
		bool "Build with support for NSS for SSL"
		help
			SSL allows sessions between upsd and clients to be encrypted and can
			also be used to authenticate servers. This means that stealing port
			3493 from upsd will no longer net you interesting passwords.
		default y

	config NUT_SSL_CERTVERIFY
		depends on PACKAGE_nut && (NUT_SSL || NUT_SSL_NSS)
		bool "Build with support for certificate verification when using SSL"
		help
			When using SSL, enables configuration options for verification of peer's
			certificate before connecting to the peer.
		default  y

	config NUT_DRIVER_USB
		depends on PACKAGE_nut
		bool "Build with support for USB drivers"
		help
			If you have a UPS connected via USB, select this.
		default y

	config NUT_DRIVER_SNMP
		depends on PACKAGE_nut
		bool "Build with support for SNMP drivers"
		help
			If you have a UPS you can connect to via SNMP, select this.
		default n

	config NUT_DRIVER_SERIAL
		depends on PACKAGE_nut
		bool "Build with support for serial drivers"
		help
			If you have a UPS connected via serial cable, select this.
		default y

	config NUT_DRIVER_NEON
		depends on PACKAGE_nut
		bool "Build with support for netxml drivers"
		help
			If you have a UPS connected via netxml, select this.
		default y
```

## net/ocserv/Config.in
```kconfig
# ocserv avanced configuration

menu "Configuration"
	depends on PACKAGE_ocserv

config OCSERV_PAM
	bool "enable PAM"
	default n

config OCSERV_SECCOMP
	bool "enable seccomp"
	depends on !arc
	default n

config OCSERV_RADIUS
	bool "enable radius authentication"
	default n

config OCSERV_LIBOATH
	bool "enable OTP"
	default n

config OCSERV_PROTOBUF
	bool "use external libprotobuf"
	default y

endmenu
```

## net/openconnect/Config.in
```kconfig
# openconnect avanced configuration

menu "Configuration"
	depends on PACKAGE_openconnect

choice
	prompt "SSL library"
	default OPENCONNECT_GNUTLS

config OPENCONNECT_GNUTLS
	bool "GnuTLS support"

config OPENCONNECT_OPENSSL
	bool "OpenSSL"

endchoice

endmenu
```

## net/ripe-atlas/Config.in
```kconfig
choice RIPE_ATLAS_PROBE_TYPE
	prompt "Probe Type"
	default RIPE_ATLAS_PROBE_TYPE_GENERIC
	help
	  Select probe type to build. Set to "Generic" if unsure.

config RIPE_ATLAS_PROBE_TYPE_GENERIC
	bool "Generic"
	help
	  Generic software probe.

config RIPE_ATLAS_PROBE_TYPE_V3
	bool "HWProbe V3"
	help
	  Hardware Probe V3.

config RIPE_ATLAS_PROBE_TYPE_V4
	bool "HWProbe V4"
	help
	  Hardware Probe V4.

config RIPE_ATLAS_PROBE_TYPE_V5
	bool "HWProbe V5"
	help
	  Hardware Probe V5.
endchoice
```

## net/rsync/Config.in
```kconfig
if PACKAGE_rsync

	config RSYNC_xattr
		bool
		prompt "Enable xattr support"
		default y if USE_FS_ACL_ATTR
		default n

	config RSYNC_acl
		bool
		prompt "Enable ACL support"
		default y if USE_FS_ACL_ATTR
		default n

	config RSYNC_zstd
		bool
		prompt "Enable zstd stream compression"
		default n

	config RSYNC_lz4
		bool
		prompt "Enable lz4, extremely fast compression"
		default n

	config RSYNC_xxhash
		bool
		prompt "Enable xxhash, extremely fast hash"
		default n

endif
```

## net/samba4/Config.in
```kconfig
menu "Configuration"
	depends on PACKAGE_samba4

config SAMBA4_SERVER
	bool "Server"
	default y
	help
		Installs: smbd smbpasswd pdbedit testparm smbstatus
	select BUSYBOX_CONFIG_RENICE
	select BUSYBOX_DEFAULT_RENICE

		config SAMBA4_SERVER_NETBIOS
			depends on SAMBA4_SERVER
			bool "enable Netbios support"
			default y
			help
				installs: nmbd nmblookup
		
		config SAMBA4_SERVER_AVAHI
			depends on SAMBA4_SERVER
			bool "enable AVAHI support"
			default n

		config SAMBA4_SERVER_VFS
			depends on SAMBA4_SERVER
			bool "enable common VFS modules"
			default y
			help
				supported modules are:
					vfs_btrfs vfs_fruit vfs_shadow_copy vfs_shadow_copy2 vfs_shell_snap vfs_recycle vfs_fake_perms vfs_default_quota vfs_readonly
					vfs_cap	vfs_xattr_tdb vfs_streams_xattr vfs_aio_fork vfs_aio_pthread vfs_offline vfs_linux_xfs_sgid vfs_crossrename
		
config SAMBA4_CLIENT
	depends on PACKAGE_samba4
	bool "Client tool"
	default n
	help
		installs: smbclient smbstatus

config SAMBA4_NET
	depends on PACKAGE_samba4
	bool "Admin tools (net)"
	default n
	help
		installs: net smbtree smbcontrol smbget profiles rpcclient smbstatus
endmenu
```

## net/samba4x/Config.in
```kconfig
if PACKAGE_samba4x-common

config SAMBA4X_AVAHI
    bool
    default n
    prompt "Build with avahi support"

config SAMBA4X_CEPHFS
    bool
    default n
    prompt "Build with cephfs support"

config SAMBA4X_CUPS
    bool
    default n
    prompt "Build with cups support"

config SAMBA4X_FAULT_HANDLING
    bool
    default n
    prompt "Build with fault handler support"

config SAMBA4X_GLUSTERFS
    bool
    default n
    prompt "Build with glusterfs support"

config SAMBA4X_IPRINT
    bool
    default n
    prompt "Build with iprint support"

config SAMBA4X_PTHREADPOOL
    bool
    default n
    prompt "Build with pthreadpool support"

config SAMBA4X_PYTHON
    bool
    default n
    prompt "Build with python modules"

config SAMBA4X_RPATH
    bool
    default n
    prompt "Enable use of rpath for build binaries"

config SAMBA4X_RPATH_INSTALL
    bool
    default n
    prompt "Enable use of rpath for library path in installed files"

config SAMBA4X_RPATH_PRIVATE_INSTALL
    bool
    default n
    prompt "Enable use of rpath for private library path in installed files"

config SAMBA4X_ACL
    bool
    default n
    prompt "Build with acl support"

config SAMBA4X_ADS
    bool
    default n
    prompt "Build with ads support"

config SAMBA4X_AD_DC
    bool
    default n
    prompt "Enable AD DC functionality (enables only Samba FS (File Server, Winbind, NMBD) and client utilities"

config SAMBA4X_AUTOMOUNT
    bool
    default n
    prompt "Build with automount support"

config SAMBA4X_DMAPI
    bool
    default n
    prompt "Build with dmapi support"

config SAMBA4X_DNSUPDATE
    bool
    default n
    prompt "Build with dnsupdate support"

config SAMBA4X_FAM
    bool
    default n
    prompt "Build with fam support"

config SAMBA4X_ICONV
    bool
    default n
    prompt "Build with iconv support"

config SAMBA4X_LDAP
    bool
    default n
    prompt "Build with ldap support"

config SAMBA4X_LIBARCHIVE
    bool
    default n
    prompt "Build with libarchive support"

config SAMBA4X_LTTNG
    bool
    default n
    prompt "Enable lttng integration"

config SAMBA4X_PAM
    bool
    default n
    prompt "Build with pam support"

config SAMBA4X_QUOTAS
    bool
    default n
    prompt "Build with quotas support"

config SAMBA4X_REGEDIT
    bool
    default n
    prompt "Build with regedit support"

config SAMBA4X_RELRO
    bool
    default n
    prompt "Build with full RELocation Read-Only(RELRO) support"

config SAMBA4X_SYSTEMD
    bool
    default n
    prompt "Build with systemd integration"

config SAMBA4X_UTMP
    bool
    default n
    prompt "Build with utmp support"

config SAMBA4X_WINBIND
    bool
    default n
    prompt "Build with winbind support"

endif
```

## net/seafile-server/Config.in
```kconfig
menu "Configuration"
	depends on PACKAGE_seafile-server

config SEAFILE_FUSE_SUPPORT
	bool "Enable FUSE support"
	select PACKAGE_libfuse
	default n

config SEAFILE_CONSOLE_SUPPORT
	bool "Enable seafile server console"
	default n

config SEAFILE_RIAK_SUPPORT
	bool "Enable support for riak backend"
	default n
endmenu
```
