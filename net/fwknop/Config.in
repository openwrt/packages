## net/snode.c/Config.in
```kconfig
menu "Configuration"
	depends on PACKAGE_snode.c-utils

	config SNODEC_GROUP_NAME
		string "Group name of unix group used for config/log/pid file management"
		default snodec
		help
				The group name for unix group used for permission management of
				config, log, and pid files.
				(default: snodec)

	choice
		depends on PACKAGE_snode.c-core
		prompt "I/O Multiplexer"
		default SNODEC_EPOLL
		help
				The I/O multiplexer SNode.C will use by default.
				Possible choices:
				  * epoll (default)
				  * poll
				  * select

		config SNODEC_EPOLL
			select PACKAGE_snode.c-core-mux-epoll
			bool "epoll"
			help
					If choosen SNode.C will use 'epoll' as default I/O multiplexer.
					(overrideable with LD_PRELOAD)

		config SNODEC_POLL
			select PACKAGE_snode.c-core-mux-poll
			bool "poll"
			help
					If choosen SNode.C will use 'poll' as default I/O multiplexer.
					(override with LD_PRELOAD)

		config SNODEC_SELECT
			select PACKAGE_snode.c-core-mux-select
			bool "select"
			help
					If choosen SNode.C will use 'select' as default I/O multiplexer.
					(override with LD_PRELOAD)
	endchoice

	menu "Socket connection behavior"
		depends on PACKAGE_snode.c-core-socket

		config SNODEC_READ_BLOCKSIZE
			int
			prompt "Read block size in bytes"
			default 16384
			help
					Read block size in bytes.
					(default: 16384)

		config SNODEC_WRITE_BLOCKSIZE
			int
			prompt "Write block size in bytes"
			default 16384
			help
					Write block size in bytes.
					(default: 16384)

		config SNODEC_READ_TIMEOUT
			int
			prompt "Read inactivity timeout in seconds"
			default 60
			help
					Read inactivity timeout after which a connection is aborted.
					(default: 60, 0 = unlimited)

		config SNODEC_WRITE_TIMEOUT
			int
			prompt "Write inactivity timeout in seconds"
			default 60
			help
					Write inactivity timeout after which a connection is aborted.
					(default: 60, 0 = unlimited)
	endmenu

	menu "Server (stream) behavior"
		depends on PACKAGE_snode.c-core-socket-stream

		config SNODEC_BACKLOG
			int
			default 5
			prompt "Listen backlog"
			help
					Listen backlog count.
					(default: 5)

		config SNODEC_ACCEPTS_PER_TICK
			int
			prompt "Accepts per tick"
			default 1
			help
					Maximum number of accepted connections per tick.
					(default: 1)
	endmenu

	menu "Socket (stream) behavior"
		depends on PACKAGE_snode.c-core-socket-stream

		config SNODEC_ACCEPT_TIMEOUT
			int
			default 0
			prompt "Accept inactivity timeout in seconds"
			help
					Accept inactivity (no new connection attempts) after which a server
					is taken offline.
					(default: 0, 0 = unlimited)

		config SNODEC_CONNECT_TIMEOUT
			int
			default 10
			prompt "Connect timeout in seconds"
			help
					Timeout in seconds after which a connect attempt will be aborted if the
					connection can not be established.
					(default: 10, 0 = unlimited)

		config SNODEC_TERMINATE_TIMEOUT
			int
			prompt "Shutdown timeout in seconds"
			default 1
			help
					Shutdown timeout after which a connection is aborted.
					(default: 1)

		menuconfig SNODEC_RECONNECT
			bool
			default n
			prompt "Reconnect after disconnect"
			help
					Reconnect to a server if a previous connection was lost.
					(default: n)

		config SNODEC_RECONNECT_TIME
		    depends on SNODEC_RECONNECT
			string
			default 1
			prompt "Reconnect time in seconds"
			help
					Duration after disconnecting bevore reconnecting.
					(default: 1)

		menuconfig SNODEC_RETRY
			bool
			default n
			prompt "Retry listen and connect"
			help
					Retry *listen* in case the socket address/port is already in use.
					Retry *connect* in case the connection to the peer could not be established.
					(default: n)

		config SNODEC_RETRY_TIMEOUT
		    depends on SNODEC_RETRY
			int
			default 1
			prompt "Retry interval in seconds"
			help
					The retry interval between two connect attempts, modified with jitter and
					exponential increase.
					(default: 1)

		config SNODEC_RETRY_TRIES
		    depends on SNODEC_RETRY
			int
			default 0
			prompt "Upper limit of retry tries"
			help
					The upper limit of retries to listen on an address or to connect to a peer.
					(default: 0, 0 = unlimited)

		config SNODEC_RETRY_BASE
		    depends on SNODEC_RETRY
			string
			default "1.8"
			prompt "Base of exponential increase"
			help
					The current retry timeout is multiplied by this value for each retry.
					(default: 1.8)

		config SNODEC_RETRY_JITTER
		    depends on SNODEC_RETRY
			int
			default 0
			prompt "Jitter of retry timeout in percent"
			help
					Maximum jitter in percent applied randomly to the calculated retry timeout.
					(default: 0, 0 = disable)

		config SNODEC_RETRY_LIMIT
		    depends on SNODEC_RETRY
			int
			default 0
			prompt "Upper limit of retry timeout in seconds"
			help
					Upper limit for the retry timeout even if the calculated timeout is greater.
					(default: 0, 0 = unlimited)

		config SNODEC_REUSE_ADDRESS
			bool
			default n
			prompt "Reuse address"
			help
					Whether the socket address should be immediately reusable or not.
					(default: n)

		config SNODEC_REUSE_PORT
			depends on PACKAGE_snode.c-net-in || PACKAGE_snode.c-net-in6
			bool
			default n
			prompt "Reuse port (IPv4/IPv6)"
			help
					If selected, the port can be reused for further IPv4 or IPv6 servers.
					Under Linux this makes it is possible to create a simple "multitasking" server.
					(default: n)

		config SNODEC_IPV6_ONLY
			depends on PACKAGE_snode.c-net-in6
			bool
			default n
			prompt "IPv6 only"
			help
					If selected, an IPv6 server only accepts IPv6 (single-stack) connections.
					If not selected, IPv4 connections are also accepted (dual stack).
					(default: n)

		config SNODEC_IPV4_MAPPED
			depends on PACKAGE_snode.c-net-in6
			bool
			default n
			prompt "IPv4-mapped IPv6 addresses"
			help
					If selected, domain names can also be resolved to IPv4-mapped IPv6 addresses.
					(default: n)
	endmenu

	menu "SSL/TLS behavior"
		depends on PACKAGE_snode.c-core-socket-stream-tls

		config SNODEC_TLS_INIT_TIMEOUT
			int
			prompt "SSL/TLS initial handshake timeout in seconds"
			default 10
			help
					Maximum duration of the initial SSL/TLS handshake befor a connection is aborted.
					(default: 10)

		config SNODEC_TLS_SHUTDOWN_TIMEOUT
			int
			prompt "SSL/TLS teardown timeout in seconds"
			default 2
			help
					Maximum duration of the SSL/TLS shutdown before a connection is aborted.
					(default: 2)
	endmenu
endmenu
```

## net/snort/Config.in
```kconfig
menu "Configuration"
	depends on PACKAGE_snort

config SNORT_MYSQL
	bool "Enable MySQL support"
	default n
	help
           This option enables support for logging to a MySQL database.
           Disabled by default.

config SNORT_PGSQL
	bool "Enable PostgreSQL support"
	default n
	help
           This option enables support for logging to a PostgreSQL database.
           Disabled by default.

config SNORT_LZMA
	bool "Enable LZMA support"
	default n
	help
           This option enables LZMA decompression.
           Disabled by default.

endmenu
```

## net/squid-4x/Config.in
```kconfig
if PACKAGE_squid-4x

	comment "Optional features"

	config SQUID_enable-ipv6
		bool "Enable support for IP version 6"
		default y

	config SQUID_enable-snmp
		bool "Enable SNMP monitoring support"
		default n

	config SQUID_enable-icmp
		bool "Enable ICMP pinging and Network Measurement"
		default n

	config SQUID_enable-icap-client
		bool "Enable ICAP client support"
		default n

	config SQUID_enable-dlmalloc
		bool "Compile & use the malloc package by Doug Lea"
		default y

	config SQUID_enable-ssl-crtd
		bool "Enable dynamic SSL certificate generation "
		depends on !SQUID_use-gnutls
		default n

	config SQUID_auth-basic
		bool "Enable the Basic authentication scheme"
		default n

	config SQUID_auth-digest
		bool "Enable the Digest authentication scheme"
		default n

	config SQUID_auth-negotiate
		bool "Enable the Negotiate authentication scheme"
		default n

	config SQUID_auth-ntlm
		bool "Enable the NTLM authentication scheme"
		default n

	comment "Optional packages"

	config SQUID_use-gnutls
		bool "Use GnuTLS instead of OpenSSL"
		default n

	config SQUID_with-libcap
		bool "Use libcap - Linux capabilities library"
		default n

	config SQUID_with-nettle
		bool "Use nettle - GNU crypto library"
		default n

	config SQUID_with-expat
		bool "Use expat - XML parsing library"
		default n

	config SQUID_with-libxml2
		bool "Use libxml2 - Gnome XML library"
		default n

	comment "Additional tools"

endif
```

## net/strongswan/Config.in
```kconfig
if PACKAGE_strongswan
comment "Configuration"

# --with-routing-table
config STRONGSWAN_ROUTING_TABLE
	string
	prompt "Set the IPsec routing table ID"
	default "220"

#  --with-routing-table-prio
config STRONGSWAN_ROUTING_TABLE_PRIO
	string
	prompt "Set the IPsec routing table priority"
	default "220"

config STRONGSWAN_INCLUDE_INSECURE
	bool
	prompt "Include cryptographically weak protocols"
	default !PACKAGE_libopenssl

comment "Packages"

endif
```

## net/suricata/Config.in
```kconfig
menu "Configuration"
	depends on PACKAGE_suricata

config SURICATA_LOGROTATE
	bool "Copy Suricata logrotate file"
	default n

config SURICATA_DEBUG
	bool "Enable debug output"
	default n

config SURICATA_LUA
	bool "Enable Lua support"
	default n

config SURICATA_MAGIC
	bool "Enable Libmagic support"
	default y

config SURICATA_NFLOG
	bool "Enable libnetfilter_log support"
	default n

config SURICATA_NFQ
	bool "Enable NFQUEUE support for inline IDP"
	default y

config SURICATA_PIE
	bool "Enable compiling as a position independent executable"
	default n

config SURICATA_SOCKET
	bool "Enable Unix Socket"
	default n

endmenu
```

## net/suricata6/Config.in
```kconfig
# Suricata 6 configuration
menu "Suricata 6 Options"
	menu "Engine Options"
		config SURICATA_ENABLE_LUAJIT
			bool "Enable Lua/LuaJIT Support"
			default n

		config SURICATA_ENABLE_PYTON
			bool "Enable Python Support"
			default n

		config SURICATA_ENABLE_GCCPROTECT
			bool "Enable GCC Hardening Options"
			default n

		config SURICATA_ENABLE_GCCPROFILE
			bool "Enable GCC Profile Info (-pg flag set)"
			default n
	endmenu

	config SURICATA_ENABLE_PROFILING
		bool "Enable Performance Profiling"
		default n

	config SURICATA_ENABLE_NFQUEUE
		bool "Enable NFQueue Support"
		default n

        config SURICATA_ENABLE_NFLOG
                bool "Enable NFLog Support"
                default n

	config SURICATA_ENABLE_GEOIP
		bool "Enable GeoIP2 Support"
		default n

	config SURICATA_ENABLE_LIBMAGIC
		bool "Enable LibMagic Support"
		default y

	config SURICATA_ENABLE_DEBUG
		bool "Enable Debug Output"
		default n

	config SURICATA_ENABLE_HIREDIS
		bool "Enable Hiredis Support"
		default y

	config SURICATA_ENABLE_EBPF
		bool "Enable eBPF Support"
		default n
endmenu
```

## net/transmission/Config.in
```kconfig
menu "Transmission configuration"
	depends on PACKAGE_transmission-daemon || PACKAGE_transmission-cli || PACKAGE_transmission-remote

choice
	prompt "SSL library"
	default TRANSMISSION_OPENSSL

config TRANSMISSION_OPENSSL
	bool "OpenSSL"

config TRANSMISSION_POLARSSL
	bool "PolarSSL"

endchoice

endmenu
```

## net/zerotier/Config.in
```kconfig
menu "Configuration"
	depends on PACKAGE_zerotier

config ZEROTIER_ENABLE_DEBUG
	bool "Build in debug mode"
	depends on PACKAGE_zerotier
	default n

config ZEROTIER_ENABLE_PORTMAPPING
	bool "Build with MiniUPnPc and NAT-PMP support"
	depends on PACKAGE_zerotier
	default n

config ZEROTIER_ENABLE_CLUSTER
	bool "Build with cluster support"
	depends on PACKAGE_zerotier
	default n

config ZEROTIER_ENABLE_SELFTEST
	bool "Build self test program"
	depends on PACKAGE_zerotier
	default n

endmenu
```
