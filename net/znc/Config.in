## net/znc/Config.in
```kconfig
# SPDX-Identifier-License: GPL-2.0-only
#
# Copyright (C) 2010-2016 OpenWrt.org
#
#

menu "Configuration"
  depends on PACKAGE_znc

config ZNC_ICU
  bool
  prompt "Enable ICU character encoding support."
  help
    Allows configuration of the charset used between clients and ZNC, and
    between ZNC and the IRC server".

endmenu
```

## routing/oonf-olsrd2/Config.in
```kconfig
	# OONF Olsrd2 configuration
	menu "Optional Plugins"
		depends on PACKAGE_oonf-olsrd2

	config OONF_NHDP_AUTOLL4
		bool "Auto_LL4 plugin enabled"
		help
			The auto_ll4 plugin automatically generates linklocal IPv4 addresses on interfaces that do not contain IPv4 addresses.
		default n

	config OONF_OLSRV2_LAN_IMPORT
		bool "Lan_import plugin enabled"
		help
			The lan_import plugin can read routing tables and automatically export them as locally attached networks in olsrd2.
		default n

	config OONF_OLSRV2_ROUTE_MODIFIER
		bool "route_modifier plugin enabled"
		help
			The route_modifier plugin allows you to overwrite aspects of routes (like table/protocol) for certain destinations. 
		default n

	config OONF_GENERIC_DLEP_ROUTER
		bool "dlep_router plugin enabled"
		help
			The dlep_router plugin can receive linklayer metadata over the DLEP protocol. 
		default n

	config OONF_GENERIC_REMOTECONTROL
		bool "remotecontrol plugin enabled"
		help
			The remotecontrol plugin allows you to control configuration and logging over the telnet plugin. Be careful not to open this functionality over the network without securing it.
		default n

	config OONF_GENERIC_HTTP
		bool "http plugin enabled"
		help
			The HTTP plugin allows HTTP access to all telnet commands.
		default n

	config OONF_OLSRV2_MPR
		bool "MPR plugin enabled"
		help
			The MPR plugin reduce the routing graph to limit the overhead of the OLSRv2 protocol
		default n

	endmenu
```

## sound/snapcast/Config.in
```kconfig
menu "Select Snapcast Options"
	depends on PACKAGE_snapcast
	comment "Choose server or client"
	config PACKAGE_snapserver
		prompt "Snapserver"
		help
			Snapcast server
		default n

	config PACKAGE_snapclient
		prompt "Snapclient"
		help
			Snapcast client
		default y
endmenu
```

## sound/squeezelite/Config.in
```kconfig
# Squeezelite configuration

if PACKAGE_squeezelite

config SQUEEZELITE_FLAC
	bool "FLAC decode support"
	select PACKAGE_libflac
	help
		libflac will be included in the image
	default n

config SQUEEZELITE_MAD
	bool "MP3 decode support"
	select PACKAGE_libmad
	help
		libmad will be included in the image
	default n

config SQUEEZELITE_OGG
	bool "OGG decode support"
	select PACKAGE_libvorbis
	help
		libvorbis will be included in the image
	default n

config SQUEEZELITE_AAC
	bool "AAC decode support"
	select PACKAGE_libfaad2
	help
		libfaad2 will be included in the image
	default n

endif
```

## utils/btrfs-progs/Config.in
```kconfig
if PACKAGE_btrfs-progs

config BTRFS_PROGS_ZSTD
	bool "Build with zstd support"
	depends on PACKAGE_libzstd
	default n
	help
		This allows you to manage BTRFS with zstd compression

endif
```

## utils/cgminer/Config.in
```kconfig
choice
	prompt "Default Miner"
	default CGMINER_AVALON6
	help
		Build driver for specific miner. It only support one type of miner caused by different configurations.

	config CGMINER_AVALON6
		bool "AvalonMiner 6.0"

	config CGMINER_AVALON_MINER
		bool "AvalonMiner nano 2 or AvalonMiner 4 mini"

	config CGMINER_ICARUS
		bool "Icarus miner"

	config CGMINER_BFL
		bool " ButterflyLabs miner"
endchoice
```

## utils/dbus/Config.in
```kconfig
if PACKAGE_dbus

config DBUS_VERBOSE
	bool "Enable verbose error strings"
	default n

endif
```

## utils/docker-ce/Config.in
```kconfig
if PACKAGE_docker-ce
	config DOCKER_KERNEL_OPTIONS
		bool "Enable Basic kernel support for Docker"
		default n
		select KERNEL_CGROUPS
		select KERNEL_CGROUP_CPUACCT
		select KERNEL_CGROUP_SCHED
		select KERNEL_NAMESPACES
		select KERNEL_CPUSETS
		select KERNEL_MEMCG
		select KERNEL_KEYS
		select KERNEL_LXC_MISC
		select KERNEL_POSIX_MQUEUE
		help
		  Select needed kernel options for Docker. Options include
		  cgroups, namespaces and other miscellaneous options.
		  see also https://github.com/docker/engine/blob/master/contrib/check-config.sh

	config DOCKER_SECCOMP
		bool "Enable support for seccomp in Docker"
		default n
		select KERNEL_SECCOMP
		select PACKAGE_libseccomp
		help
		  Build Docker with support for seccomp filters.
		  Select libseccomp which also pulls-in the needed kernel features.

	config DOCKER_RES_SHAPE
		bool "Enables support for resource shaping"
		default n
		select KERNEL_MEMCG_SWAP
		select KERNEL_MEMCG_SWAP_ENABLED
		select KERNEL_BLK_DEV_THROTTLING
		select KERNEL_CGROUP_PERF
		select KERNEL_FAIR_GROUP_SCHED
		select KERNEL_CFS_BANDWIDTH
		select KERNEL_RT_GROUP_SCHED

	menu "Network"
		config DOCKER_NET_OVERLAY
			bool "Enables the Overlay network feature"
			default n
			select PACKAGE_kmod-udptunnel4
			help
			  Selects kernel options for the Overlay network feature.
			  Includes udptunnel4

		config DOCKER_NET_ENCRYPT
			bool "Enable encrypted networking kernel support"
			depends on DOCKER_NET_OVERLAY
			default n
			select PACKAGE_kmod-ipsec
			select PACKAGE_kmod-ipsec4
			select PACKAGE_kmod-crypto-gcm
			select PACKAGE_kmod-crypto-ghash
			help
			  Select needed kernel options for encrypted networking support.

		config DOCKER_NET_MACVLAN
			bool "Enables macvlan kernel support"
			default n
			select PACKAGE_kmod-macvlan
			select PACKAGE_kmod-dummy

		config DOCKER_NET_TFTP
			bool "Enable ftp/tftp client kernel support"
			default n
			select PACKAGE_kmod-nf-nathelper
			select PACKAGE_kmod-nf-nathelper-extra
	endmenu

	menu "Storage"
		config DOCKER_STO_EXT4
			bool "Enables support for ext3 or ext4 as the backing filesystem"
			default n
			select KERNEL_EXT4_FS_POSIX_ACL

		config DOCKER_STO_BTRFS
			bool "Enables support for btrfs as the backing filesystem"
			default n
			select PACKAGE_kmod-fs-btrfs
			select KERNEL_BTRFS_FS_POSIX_ACL
	endmenu
endif
```

## utils/domoticz/Config.in
```kconfig
config DOMOTICZ_OZW_SUPPORT
	bool "OpenZWave support"
	default n

config DOMOTICZ_WIREPI_SUPPORT
	bool "WiringPi Rasberry PI GPIO support"
	default n

config DOMOTICZ_RPITOOLS_SUPPORT
	bool "Rasberry PI userland tools support"
	default n
```

## utils/dump1090/Config.in
```kconfig
config DUMP1090_DUMP
	bool "dump1090"
	depends on PACKAGE_dump1090
	default y
	help
		dump1090 ModeS Receiver

config DUMP1090_WWW
	bool "website files"
	depends on DUMP1090_DUMP
	default y
	help
		HTML website files for showing planes

config DUMP1090_VIEW
	bool "view1090"
	depends on PACKAGE_dump1090
	default n
	help
		view1090 dump1090 Viewer
```

## utils/f2fs-tools/Config.in
```kconfig
menu "Configuration"
        depends on PACKAGE_f2fs-tools

config F2FS_UTILS_f2fstat
	bool "Install f2fstat utility"
	default y

config F2FS_UTILS_fibmap_f2fs
	bool "Install fibmap.f2fs utility"
	default y

config F2FS_UTILS_fsck_f2fs
	bool "Install fsck.f2fs utility"
	default y

config F2FS_UTILS_dump_f2fs
	bool "Install dump.f2fs utility"
	select F2FS_UTILS_fsck_f2fs
	default y

config F2FS_UTILS_mkfs_f2fs
	bool "Install mkfs.f2fs utility"
	default y

endmenu
```

## utils/flashrom/Config.in
```kconfig
menu "Flashrom configuration"
	depends on PACKAGE_flashrom

	choice
		prompt "Default Programmer"
		default DEFPROG_INTERNAL if FLASHROM_PCI
		default DEFPROG_LINUX_SPI

		config DEFPROG_INTERNAL
			depends on FRPROG_INTERNAL
			bool "Internal"

		config DEFPROG_LINUX_SPI
			depends on FRPROG_LINUX_SPI
			bool "Linux SPI"

		config DEFPROG_SERPROG
			depends on FRPROG_SERPROG
			bool "Serial"

		config DEFPROG_RAYER_SPI
			depends on FRPROG_RAYER_SPI
			bool "Rayer SPI"

		config DEFPROG_PONY_SPI
			depends on FRPROG_PONY_SPI
			bool "Pony SPI"

		config DEFPROG_NIC3COM
			depends on FRPROG_NIC3COM
			bool "NIC3Com"

		config DEFPROG_GFXNVIDIA
			depends on FRPROG_GFXNVIDIA
			bool "GFX Nvidia"

		config DEFPROG_SATASII
			depends on FRPROG_SATASII
			bool "SATASII"

#		config DEFPROG_ATAHPT
#			depends on FRPROG_ATAHPT
#			bool "Highpoint (HPT) ATA/RAID"

		config DEFPROG_ATAVIA
			depends on FRPROG_ATAVIA
			bool "ATAVIA"

		config DEFPROG_FT2232_SPI
			depends on FRPROG_FT2232_SPI
			bool "FT2232 SPI"

		config DEFPROG_USBBLASTER_SPI
			depends on FRPROG_USBBLASTER_SPI
			bool "USBBlaster SPI"

#		config DEFPROG_MSTARDDC_SPI
#			depends on FRPROG_MSTARDDC_SPI
#			bool "MSTAR DDC SPI"

		config DEFPROG_PICKIT2_SPI
			depends on FRPROG_PICKIT2_SPI
			bool "PICkit2 SPI"

		config DEFPROG_DUMMY
			depends on FRPROG_DUMMY
			bool "Dummy"

		config DEFPROG_DRKAISER
			depends on FRPROG_DRKAISER
			bool "Dr. Kaiser"

		config DEFPROG_NICREALTEK
			depends on FRPROG_NICREALTEK
			bool "Realtek NICs"

#		config DEFPROG_NICNATSEMI
#			depends on FRPROG_NICNATSEMI
#			bool "National Semiconductor NICs"

		config DEFPROG_NICINTEL
			depends on FRPROG_NICINTEL
			bool "Intel NICs"

		config DEFPROG_NICINTEL_SPI
			depends on FRPROG_NICINTEL_SPI
			bool "Intel NICs SPI"

		config DEFPROG_NICINTEL_EEPROM
			depends on FRPROG_NICINTEL_EEPROM
			bool "Intel NICs EEPROM"

		config DEFPROG_OGP_SPI
			depends on FRPROG_OGP_SPI
			bool "OGP SPI"

		config DEFPROG_BUSPIRATE_SPI
			depends on FRPROG_BUSPIRATE_SPI
			bool "SPI BUS Pirate"

#		config DEFPROG_DEDIPROG
#			depends on FRPROG_DEDIPROG
#			bool "Dediprog SF100"

		config DEFPROG_SATAMV
			depends on FRPROG_SATAMV
			bool "Marvell SATA"

		config DEFPROG_IT8212
			depends on FRPROG_IT8212
			bool "ITE IT8212F PATA"
	endchoice


	menu "Misc Programmers"
		config FRPROG_LINUX_SPI
			bool "Linux SPI"
			default y

#		config FRPROG_MSTARDDC_SPI
#			bool "MSTAR DDC"
#			default n

		config FRPROG_DUMMY
			bool "Dummy"
			default y
	endmenu


	config FLASHROM_FTDI
		bool "FTDI Support"
		default y

	menu "FTDI Programmers"
		depends on FLASHROM_FTDI

		config FRPROG_FT2232_SPI
			depends on FLASHROM_FTDI
			bool "FT2232 SPI"
			default y

		config FRPROG_USBBLASTER_SPI
			depends on FLASHROM_FTDI
			bool "USBBlaster SPI"
			default y
	endmenu


	config FLASHROM_PCI
		bool "PCI Support"
		default y if (TARGET_x86||TARGET_x86_64)

	menu "PCI Programmers"
		depends on FLASHROM_PCI

		config FRPROG_INTERNAL
			depends on FLASHROM_PCI
			bool "Internal"
			default y

		config FRPROG_RAYER_SPI
			depends on FLASHROM_PCI
			bool "Rayer SPI"
			default y

		config FRPROG_NIC3COM
			depends on FLASHROM_PCI
			bool "NIC3Com"
			default y

		config FRPROG_GFXNVIDIA
			depends on FLASHROM_PCI
			bool "GFX Nvidia"
			default y

		config FRPROG_SATASII
			depends on FLASHROM_PCI
			bool "SATASII"
			default y

#		config FRPROG_ATAHPT
#			depends on FLASHROM_PCI
#			bool "Highpoint (HPT) ATA/RAID"
#			default n

		config FRPROG_ATAVIA
			depends on FLASHROM_PCI
			bool "ATAVIA"
			default y

		config FRPROG_IT8212
			depends on FLASHROM_PCI
			bool "ITE IT8212F PATA"
			default y

		config FRPROG_DRKAISER
			depends on FLASHROM_PCI
			bool "Dr. Kaiser"
			default y

		config FRPROG_NICREALTEK
			depends on FLASHROM_PCI
			bool "Realtek NICs"
			default y

#		config FRPROG_NICNATSEMI
#			depends on FLASHROM_PCI
#			bool "National Semiconductor NICs"
#			default n

		config FRPROG_NICINTEL
			depends on FLASHROM_PCI
			bool "Intel NICs"
			default y

		config FRPROG_NICINTEL_SPI
			depends on FLASHROM_PCI
			bool "Intel NICs SPI"
			default y

		config FRPROG_NICINTEL_EEPROM
			depends on FLASHROM_PCI
			bool "Intel NICs EEPROM"
			default y

		config FRPROG_OGP_SPI
			depends on FLASHROM_PCI
			bool "OGP SPI"
			default y

		config FRPROG_SATAMV
			depends on FLASHROM_PCI
			bool "Marvell SATA"
			default y
	endmenu


	config FLASHROM_SERIAL
		bool "Serial Support"
		default y

	menu "Serial Programmers"
		depends on FLASHROM_SERIAL

		config FRPROG_SERPROG
			depends on FLASHROM_SERIAL
			bool "Serial"
			default y

		config FRPROG_PONY_SPI
			depends on FLASHROM_SERIAL
			bool "Pony SPI"
			default y

		config FRPROG_BUSPIRATE_SPI
			depends on FLASHROM_SERIAL
			bool "SPI BUS Pirate"
			default y
	endmenu


	config FLASHROM_USB
		bool "USB Support"
		default y

	menu "USB Programmers"
		depends on FLASHROM_USB

		config FRPROG_PICKIT2_SPI
			depends on FLASHROM_USB
			bool "PICkit2 SPI"
			default y

#		config FRPROG_DEDIPROG
#			depends on FLASHROM_USB
#			bool "Dediprog SF100"
#			default n
	endmenu
endmenu
```

## utils/fwupd/Config.in
```kconfig
menu "Select fwupd options"

config FWUPD_FIRMWARE_PACKAGER
	bool "firmware packager"
	default n
	help
	  Compile fwupd with firmware packager

config FWUPD_HSI
	bool "Host Security ID"
	default n
	help
	  Compile fwupd with HSI support

config FWUPD_LVFS
	bool "LVFS remote"
	default y
	help
	  Compile and install LVFS remote

config FWUPD_GNUTLS
	bool "gnutls"
	default n
	help
	  Compile fwupd with GnuTLS support

config FWUPD_OPENSSL
	bool "openssl"
	default y
	help
	  Compile fwupd with OpenSSL support

config FWUPD_LIBDRM
	bool "libdrm"
	default n
	help
	  Compile fwupd with libdrm support

config FWUPD_PLUGIN_DEVLINK
	bool "devlink plugin"
	default y
	help
	  Compile fwupd with devlink plugin

config FWUPD_PLUGIN_MODEMMANAGER
	bool "ModemManager plugin"
	default y
	help
	  Compile fwupd with ModemManager plugin

endmenu
```

## utils/gl-puli-mcu/Config.in
```kconfig
choice
    depends on PACKAGE_gl-puli-mcu

    prompt "GL.iNet target"
    default GL_PULI_MCU_XE300

    config GL_PULI_MCU_XE300
            bool "GL.iNet XE300 (Puli)"

    config GL_PULI_MCU_XE3000
            bool "GL.iNet XE3000 (Puli AX)"
endchoice
```

## utils/lxc/Config.in
```kconfig
menu "Configuration"
        depends on PACKAGE_lxc

config LXC_KERNEL_OPTIONS
	bool "Enable kernel support for LXC"
	default n
	select KERNEL_CGROUPS
	select KERNEL_NAMESPACES
	select KERNEL_LXC_MISC
	help
	  Select needed kernel options for LXC related utilities. Options
	  include cgroups, namespaces and other miscellaneous options. These
	  options unfortunately can not be installed as a module.

config LXC_BUSYBOX_OPTIONS
	bool "Enable busybox support for lxc-create tool"
	default n
	select BUSYBOX_CUSTOM
	select BUSYBOX_CONFIG_HAVE_DOT_CONFIG
	select BUSYBOX_CONFIG_FEATURE_SEAMLESS_XZ
	select BUSYBOX_CONFIG_FEATURE_TAR_LONG_OPTIONS
	select BUSYBOX_CONFIG_UNXZ
	select BUSYBOX_CONFIG_XZ
	select BUSYBOX_CONFIG_GETOPT
	select BUSYBOX_CONFIG_FEATURE_GETOPT_LONG
	help
	  Select needed busybox options for lxc-create utility. This include XZ tar
	  compression, long option support for tar and built-in getopt support.

endmenu
```

## utils/mc/Config.in
```kconfig
menu "Configuration"
	depends on PACKAGE_mc

config MC_DIFF_VIEWER
	bool "Compile with diff viewer"
	default n

config MC_EDITOR
	bool "Enable internal editor"
	default n

config MC_SUBSHELL
	bool "Compile in concurrent subshell"
	default n

config MC_DISABLE_VFS
	bool "Disable VFS"
	default y

endmenu
```

## utils/pax-utils/Config.in
```kconfig
config PAX_UTILS_SECCOMP
	depends on PACKAGE_pax-utils
	bool "build with support for seccomp"
	default n
```
